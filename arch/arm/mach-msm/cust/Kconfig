## drivers/net/wireless/bcmdhd/Kconfig
```kconfig
config BCMDHD
	tristate "Broadcom 4330/34 wireless cards support"
	depends on MMC
	---help---
	  This module adds support for wireless adapters based on
	  Broadcom 4330/34 chipset.
	  This driver uses the kernel's wireless extensions subsystem.
	  If you choose to build a module, it'll be called dhd. Say M if
	  unsure.

config BCM4330
	tristate "Broadcom 4330 wireless cards support"
	depends on BCMDHD
	default n
	---help---
	  This module adds support for wireless adapters based on
	  Broadcom 4330 chipset.

config BCM4334
	tristate "Broadcom 4334 wireless cards support"
	depends on BCMDHD
	default n
	---help---
	  This module adds support for wireless adapters based on
	  Broadcom 4334 chipset.

config BCMDHD_FW_PATH
	depends on BCMDHD
	string "Firmware path"
	default "/system/vendor/firmware/fw_bcmdhd.bin"
	---help---
	  Path to the firmware file.

config BCMDHD_NVRAM_PATH
	depends on BCMDHD
	string "NVRAM path"
	default "/system/etc/wifi/nv_bcmdhd.txt"
	---help---
	  Path to the calibration file.

config BCMDHD_WEXT
	bool "Enable WEXT support"
	depends on BCMDHD && CFG80211 = n
	select WIRELESS_EXT
	select WEXT_PRIV
	---help---
	  Enables WEXT support


config BCMDHD_GPIO_WL_RESET
	depends on BCMDHD
	int "GPIO to the Reset"
	default 107
	---help---
	  GPIO to the Reset

config BCMDHD_HOSTWAKEUP_USE_GPIO
	depends on BCMDHD
	bool "Use GPIO to Host Wakeup"
	---help---
	  Use GPIO to Host Wakeup

config BCMDHD_HOSTWAKEUP_USE_SDIO
	depends on BCMDHD && BCMDHD_HOSTWAKEUP_USE_GPIO = n
	bool "Use SDIO pin to the Host Wakeup"
	---help---
	  Use SDIO pin to the Host Wakeup

config BCMDHD_GPIO_WL_HOSTWAKEUP
	depends on BCMDHD && BCMDHD_HOSTWAKEUP_USE_GPIO = y
	int "GPIO to the Host Wakeup"
	default 126
	---help---
	  GPIO to the Host Wakeup

config BCMDHD_HW_OOB
	depends on BCMDHD && BCMDHD_HOSTWAKEUP_USE_GPIO = y
	bool "Use H/W OOB to the Host Wakeup"
	default y
	---help---
	  Use H/W OOB to the Host Wakeup


config BROADCOM_WIFI_RESERVED_MEM
	bool "BROADCOM Reserved memory for wifi device"
	depends on BCMDHD
	---help---
	   This is a configuration for broadcom WLAN driver.
```
